#include <ioCC2530.h>
#include "hal_lcd.h"
#include "hal_types.h"
   
//取汉字字模，横向8点右高位   
   
__code const unsigned char asc2_1608[1520]={
0x00,0x00,0x00,0x00,0x00,0x00,0x00,0x00,0x00,0x00,0x00,0x00,0x00,0x00,0x00,0x00,
0x00,0x00,0x00,0x08,0x08,0x08,0x08,0x08,0x08,0x08,0x00,0x00,0x18,0x18,0x00,0x00,
0x00,0x48,0x6C,0x24,0x12,0x00,0x00,0x00,0x00,0x00,0x00,0x00,0x00,0x00,0x00,0x00,
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0x0C,0x32,0xC2,0x00,0x00,0x00,0x00,0x00,0x00,0x00,0x00,0x00,0x00,0x00,0x00,0x00,
};

uint16 BACK_COLOR, POINT_COLOR;   //背景色，画笔色	

void LCD_DLY_ms(unsigned int ms);
void LCD_Wrtie_Bus(char dat);
void LCD_WR_REG_DATA(uint8 reg,int da);
unsigned int mypow(uint8 m,uint8 n);

/*********************LCD 延时1ms************************************/
void LCD_DLY_ms(unsigned int ms)
{                         
    unsigned int a;
    while(ms)
    {
        a=3200;
        while(a--);
        ms--;
    }
    return;
}

/**************************************************************************************************
 * @fn      halLcd_ConfigIO
 *
 * @brief   Configure IO lines needed for LCD control.
 *
 * @param   None
 *
 * @return  None
 **************************************************************************************************/
static void halLcd_ConfigIO(void)
{
    //#define LCD_CS  	//片选直接接到了GND
    #define LCD_DC     P1_6	//A0  H/L 命令数据选通端，H：数据，L:命令
    #define LCD_SCL    P1_7     //SCLK  时钟 D0（SCLK）
    #define LCD_SDA    P1_5     //SDA   D1（MOSI） 数据
    #define LCD_REST   P1_2     //复位端
    //#define LCD_CS  接地
  
	P1SEL &= ~0xe4;          //让P12，P15，P16 P17为普通IO口
	P1DIR |= 0xe4;           //把P12，P15，P16 P17设置为输出

	LCD_DC=1;
	LCD_SCL=1;
	LCD_SDA=1;
	LCD_REST=1;
}

void LCD_Wrtie_Bus(char dat)
{
    uint8 i=0, temp=0;
    for(i=0;i<8;i++) //发送一个八位数据 
    {
        LCD_SCL=0;  
        temp = dat&0x80;
        if (temp == 0)
        {
            LCD_SDA=0;
        }
        else
        {
            LCD_SDA=1;
        }
        LCD_SCL=1;       
        dat<<=1;    
    }
}

void LCD_WR_DATA8(char dat) //发送数据(8bit的数据)
{
    LCD_DC=1;
    LCD_Wrtie_Bus(dat);
}

void LCD_WR_DATA(int dat)
{
    LCD_DC=1;
    LCD_Wrtie_Bus(dat>>8);
    LCD_Wrtie_Bus(dat);
}

void LCD_WR_REG(uint8 cmd)	 
{
    LCD_DC=0; 
    LCD_Wrtie_Bus(cmd);
}

 void LCD_WR_REG_DATA(uint8 reg,int da)
{
    LCD_WR_REG(reg);
    LCD_WR_DATA(da);
}

void Address_set(unsigned int x1,unsigned int y1,unsigned int x2,unsigned int y2)
{  
   LCD_WR_REG(0x2a);
   LCD_WR_DATA8(x1>>8);
   LCD_WR_DATA8(x1);
   LCD_WR_DATA8(x2>>8);
   LCD_WR_DATA8(x2);
  
   LCD_WR_REG(0x2b);
   LCD_WR_DATA8(y1>>8);
   LCD_WR_DATA8(y1);
   LCD_WR_DATA8(y2>>8);
   LCD_WR_DATA8(y2);

   LCD_WR_REG(0x2C);
}

#undef  USE_LANDSCAPE  

//清屏函数
//Color:要清屏的填充色
void LCD_Clear(uint16 Color)
{
	uint8 VH,VL;
	uint16 i,j;
	VH=Color>>8;
	VL=Color;	
	Address_set(0,0,LCD_W-1,160);
        
        for(i=0;i<LCD_W;i++)
             {
              for (j=0;j<LCD_H;j++)
                    {
                      LCD_WR_DATA8(VH);
                      LCD_WR_DATA8(VL);	
                    }
              }
}

void HalLcdInit(void)
{
  HalLcd_HW_Init();
}

void HalLcd_HW_Init(void)
{
        halLcd_ConfigIO();

        LCD_REST=1;
        LCD_DLY_ms(5);	
	LCD_REST=0;
	LCD_DLY_ms(5);
	LCD_REST=1;
        
        //LCD_CS=1;
        //LCD_DLY_ms(5);
        //LCD_CS=0;

        LCD_WR_REG(0x11); //Sleep out
	LCD_DLY_ms(120); //Delay 120ms
	//------------------------------------ST7735S Frame Rate-----------------------------------------//
	LCD_WR_REG(0xB1);
	LCD_WR_DATA8(0x05);


        LCD_WR_REG(0x11);//Sleep exit 
        LCD_DLY_ms (120);
         
        //ST7735R Frame Rate
        LCD_WR_REG(0xB1); 
        LCD_WR_DATA8(0x01); 
        
        LCD_WR_DATA8(0x2C); LCD_WR_DATA8(0x2D); 
        LCD_WR_REG(0xB2); 
        LCD_WR_DATA8(0x01); LCD_WR_DATA8(0x2C); LCD_WR_DATA8(0x2D); 
        LCD_WR_REG(0xB3); 
        LCD_WR_DATA8(0x01); LCD_WR_DATA8(0x2C); LCD_WR_DATA8(0x2D); 
        LCD_WR_DATA8(0x01); LCD_WR_DATA8(0x2C); LCD_WR_DATA8(0x2D); 
        
        LCD_WR_REG(0xB4); //Column inversion 
        LCD_WR_DATA8(0x07); 
         
        //ST7735R Power Sequence
        LCD_WR_REG(0xC0); 
        LCD_WR_DATA8(0xA2); LCD_WR_DATA8(0x02); LCD_WR_DATA8(0x84); 
        LCD_WR_REG(0xC1); LCD_WR_DATA8(0xC5); 
        LCD_WR_REG(0xC2); 
        LCD_WR_DATA8(0x0A); LCD_WR_DATA8(0x00); 
        LCD_WR_REG(0xC3); 
        LCD_WR_DATA8(0x8A); LCD_WR_DATA8(0x2A); 
        LCD_WR_REG(0xC4); 
        LCD_WR_DATA8(0x8A); LCD_WR_DATA8(0xEE); 
         
        LCD_WR_REG(0xC5); //VCOM 
        LCD_WR_DATA8(0x0E); 
         
        LCD_WR_REG(0x36); //MX, MY, RGB mode 
        LCD_WR_DATA8(0xC8); 
        
        //ST7735R Gamma Sequence
        LCD_WR_REG(0xe0); 
        LCD_WR_DATA8(0x0f); LCD_WR_DATA8(0x1a); 
        LCD_WR_DATA8(0x0f); LCD_WR_DATA8(0x18); 
        LCD_WR_DATA8(0x2f); LCD_WR_DATA8(0x28); 
        LCD_WR_DATA8(0x20); LCD_WR_DATA8(0x22); 
        LCD_WR_DATA8(0x1f); LCD_WR_DATA8(0x1b); 
        LCD_WR_DATA8(0x23); LCD_WR_DATA8(0x37); LCD_WR_DATA8(0x00); 
        
        LCD_WR_DATA8(0x07); 
        LCD_WR_DATA8(0x02); LCD_WR_DATA8(0x10); 
        LCD_WR_REG(0xe1); 
        LCD_WR_DATA8(0x0f); LCD_WR_DATA8(0x1b); 
        LCD_WR_DATA8(0x0f); LCD_WR_DATA8(0x17); 
        LCD_WR_DATA8(0x33); LCD_WR_DATA8(0x2c); 
        LCD_WR_DATA8(0x29); LCD_WR_DATA8(0x2e); 
        LCD_WR_DATA8(0x30); LCD_WR_DATA8(0x30); 
        LCD_WR_DATA8(0x39); LCD_WR_DATA8(0x3f); 
        LCD_WR_DATA8(0x00); LCD_WR_DATA8(0x07); 
        LCD_WR_DATA8(0x03); LCD_WR_DATA8(0x10);  
        
        LCD_WR_REG(0x2a);
        LCD_WR_DATA8(0x00);LCD_WR_DATA8(0x00);
        LCD_WR_DATA8(0x00);LCD_WR_DATA8(0x7f);
        LCD_WR_REG(0x2b);
        LCD_WR_DATA8(0x00);LCD_WR_DATA8(0x00);
        LCD_WR_DATA8(0x00);LCD_WR_DATA8(0x7f);
        
        LCD_WR_REG(0xF0); //Enable test command  
        LCD_WR_DATA8(0x01); 
        LCD_WR_REG(0xF6); //Disable ram power save mode 
        LCD_WR_DATA8(0x00); 
         
        LCD_WR_REG(0x3A); //65k mode 
        LCD_WR_DATA8(0x05); 
        LCD_WR_REG(0x29); //Display on
        LCD_WR_REG(0x2C);
}

//在指定位置显示一个汉字(32*33大小)
//dcolor为内容颜色，gbcolor为背静颜色
void showhanzi24x24(unsigned int x,unsigned int y,unsigned char index, unsigned char *temp, unsigned int pointcolor, unsigned int back_color)	
{  
	unsigned char i,j;    
    Address_set(x,y,x+23,y+23); //设置区域      
	temp+=index*72;	
	for(j=0;j<72;j++)
	{
		for(i=0;i<8;i++)
		{ 		     
		 	if((*temp&(1<<i))!=0)
			{
				LCD_WR_DATA(pointcolor);
			} 
			else
			{
				LCD_WR_DATA(back_color);
			}   
		}
		temp++;
	 }
}

//在指定位置显示一个汉字(16*16大小)
//pointcolor为内容颜色，gbcolor为背静颜色
void showhanzi16x16(unsigned int x,unsigned int y,unsigned char index,unsigned char *temp, unsigned int pointcolor, unsigned int back_color)	
{  
	unsigned char i,j;
        Address_set(x,y,x+15,y+15); //设置区域      
	temp+=index*32;	
	for(j=0;j<32;j++)
	{
		for(i=0;i<8;i++)
		{ 		     
		 	if((*temp&(1<<i))!=0)
			{
				LCD_WR_DATA(pointcolor);
			} 
			else
			{
				LCD_WR_DATA(back_color);
			}   
		}
		temp++;
	 }
}

//画点
//POINT_COLOR:此点的颜色
void LCD_DrawPoint(uint16 x,uint16 y)
{
	Address_set(x,y,x,y);//设置光标位置 
	LCD_WR_DATA(GREEN); 	    
} 	 

//画一个大点
//POINT_COLOR:此点的颜色
void LCD_DrawPoint_big(uint16 x,uint16 y)
{
	LCD_Fill(x-1,y-1,x+1,y+1,POINT_COLOR);
} 
//====================================================================================
/* 函数: void DispPic(const unsigned char *p)
   描述: 全屏显示一张图片， p 为要显示的颜色值的指针  8位格式 */
//====================================================================================
void DispPic(const unsigned char *p)
{
	unsigned int i,j;
	unsigned char pic_h,pic_l;

		//SetDisArea(0,LCD_W-1,0,LCD_H-1);
	Address_set(0,LCD_W-1,0,LCD_H-1);
	//GPIO_SetBits(GPIOB, GPIO_Pin_14); //接下来将要填充数据
	 LCD_DC=1;
	for(i=0;i<LCD_W;i++)//行
	{
	    for(j=0;j<LCD_H;j++)//列
		{    
		  pic_l=(*p);
		  pic_h=(*(p+1));
			LCD_WR_DATA(pic_h);				  
			LCD_WR_DATA(pic_l);
			p=p+2;
		}
	}
}
//在指定区域内填充指定颜色
//区域大小:
//  (xend-xsta)*(yend-ysta)
void LCD_Fill(uint16 xsta,uint16 ysta,uint16 xend,uint16 yend,uint16 color)
{          
	uint16 i,j; 
	Address_set(xsta,ysta,xend,yend);      //设置光标位置 
	for(i=ysta;i<=yend;i++)
	{													   	 	
		for(j=xsta;j<=xend;j++)LCD_WR_DATA(color);//设置光标位置 	    
	} 					  	    
}  

//画线
//x1,y1:起点坐标
//x2,y2:终点坐标  
void LCD_DrawLine(uint16 x1, uint16 y1, uint16 x2, uint16 y2)
{
	uint16 t; 
	int xerr=0,yerr=0,delta_x,delta_y,distance; 
	int incx,incy,uRow,uCol; 

	delta_x=x2-x1; //计算坐标增量 
	delta_y=y2-y1; 
	uRow=x1; 
	uCol=y1; 
	if(delta_x>0)incx=1; //设置单步方向 
	else if(delta_x==0)incx=0;//垂直线 
	else {incx=-1;delta_x=-delta_x;} 
	if(delta_y>0)incy=1; 
	else if(delta_y==0)incy=0;//水平线 
	else{incy=-1;delta_y=-delta_y;} 
	if( delta_x>delta_y)distance=delta_x; //选取基本增量坐标轴 
	else distance=delta_y; 
	for(t=0;t<=distance+1;t++ )//画线输出 
	{  
		LCD_DrawPoint(uRow,uCol);//画点 
		xerr+=delta_x ; 
		yerr+=delta_y ; 
		if(xerr>distance) 
		{ 
			xerr-=distance; 
			uRow+=incx; 
		} 
		if(yerr>distance) 
		{ 
			yerr-=distance; 
			uCol+=incy; 
		} 
	}  
}    

//画矩形
void LCD_DrawRectangle(uint16 x1, uint16 y1, uint16 x2, uint16 y2)
{
	LCD_DrawLine(x1,y1,x2,y1);
	LCD_DrawLine(x1,y1,x1,y2);
	LCD_DrawLine(x1,y2,x2,y2);
	LCD_DrawLine(x2,y1,x2,y2);
}

//在指定位置画一个指定大小的圆
//(x,y):中心点
//r    :半径
void Draw_Circle(uint16 x0,uint16 y0,uint8 r)
{
	int a,b;
	int di;
	a=0;b=r;	  
	di=3-(r<<1);             //判断下个点位置的标志
	while(a<=b)
	{
		LCD_DrawPoint(x0-b,y0-a);             //3           
		LCD_DrawPoint(x0+b,y0-a);             //0           
		LCD_DrawPoint(x0-a,y0+b);             //1       
		LCD_DrawPoint(x0-b,y0-a);             //7           
		LCD_DrawPoint(x0-a,y0-b);             //2             
		LCD_DrawPoint(x0+b,y0+a);             //4               
		LCD_DrawPoint(x0+a,y0-b);             //5
		LCD_DrawPoint(x0+a,y0+b);             //6 
		LCD_DrawPoint(x0-b,y0+a);             
		a++;
		//使用Bresenham算法画圆     
		if(di<0)di +=4*a+6;	  
		else
		{
			di+=10+4*(a-b);   
			b--;
		} 
		LCD_DrawPoint(x0+a,y0+b);
	}
} 

//在指定位置显示一个字符
//num:要显示的字符:" "--->"~"
//mode:叠加方式(1)还是非叠加方式(0)
void LCD_ShowChar(uint16 x,uint16 y,uint8 num,uint8 mode)
{
    uint8 temp;
    uint8 pos,t;
    uint16 x0=x;
    y=y;
    uint16 colortemp=POINT_COLOR;      
    if(x>LCD_W-8||y>LCD_H-16)return;	    
	//设置窗口		   
	num=num-' ';//得到偏移后的值
	Address_set(x,y,x+8-1,y+16-1);      //设置光标位置 
	if(!mode) //非叠加方式
	{
		for(pos=0;pos<16;pos++)
		{ 
		  temp=asc2_1608[(uint16)num*16+pos];		 //调用1608字体
	          for(t=0;t<8;t++)
		    {                 
		        if(temp&0x01)POINT_COLOR=colortemp;
				else POINT_COLOR=BACK_COLOR;
				LCD_WR_DATA(POINT_COLOR);	
				temp>>=1; 
				x++;
		    }
			x=x0;
			y++;
		}	
	}else//叠加方式
	{
		for(pos=0;pos<16;pos++)
		{
		    temp=asc2_1608[(uint16)num*16+pos];		 //调用1608字体
			for(t=0;t<8;t++)
		    {                 
		        if(temp&0x01)LCD_DrawPoint(x+t,y+pos);//画一个点     
		        temp>>=1; 
		    }
		}
	}
	POINT_COLOR=colortemp;	
}

//m^n函数
unsigned int mypow(uint8 m,uint8 n)
{
	unsigned int result=1;	 
	while(n--)result*=m;    
	return result;
}			 

//显示2个数字
//x,y :起点坐标	 
//len :数字的位数
//color:颜色
//num:数值(0~4294967295);	
void LCD_ShowNum(uint16 x,uint16 y,unsigned int num,uint8 len)
{         	
	uint8 t,temp;
	uint8 enshow=0;
	num=(uint16)num;
	for(t=0;t<len;t++)
	{
		temp=(num/mypow(10,len-t-1))%10;
		if(enshow==0&&t<(len-1))
		{
			if(temp==0)
			{
				LCD_ShowChar(x+8*t,y,' ',0);
				continue;
			}else enshow=1; 
		 	 
		}
	 	LCD_ShowChar(x+8*t,y,temp+48,0); 
	}
} 

//显示2个数字
//x,y:起点坐标
//num:数值(0~99);	 
void LCD_Show2Num(uint16 x,uint16 y,uint16 num,uint8 len)
{         	
	uint8 t,temp;						   
	for(t=0;t<len;t++)
	{
		temp=(num/mypow(10,len-t-1))%10;
	 	LCD_ShowChar(x+8*t,y,temp+'0',0); 
	}
} 

//显示字符串
//x,y:起点坐标  
//*p:字符串起始地址
//用16字体
void LCD_ShowString(uint16 x,uint16 y,  const uint8 *p)
{         
    while(*p!='\0')
    {       
        if(x>LCD_W-8){x=0;y+=16;}
        if(y>LCD_H-16){y=x=0;}
        LCD_ShowChar(x,y,*p,0);
        x+=8;
        p++;
    }  
}

void HalLcdWriteString(char *str, uint8 option)
{
  LCD_ShowString(0, (option-1)*16, "                ");
  LCD_ShowString(0, (option-1)*16, str);
}

/**************************************************************************************************
 * @fn      HalLcdWriteStringValue
 *
 * @brief   Write a string followed by a value to the LCD
 *
 * @param   title  - Title that will be displayed before the value
 *          value  - value
 *          format - redix
 *          line   - line number
 *
 * @return  None
 **************************************************************************************************/
void HalLcdWriteStringValue( char *title, uint16 value, uint8 format, uint8 line )
{
#if (HAL_LCD == TRUE)
  uint8 tmpLen;
  uint8 buf[HAL_LCD_MAX_BUFF];
  uint32 err;

  tmpLen = (uint8)osal_strlen( (char*)title );
  osal_memcpy( buf, title, tmpLen );
  buf[tmpLen] = ' ';
  err = (uint32)(value);
  _ltoa( err, &buf[tmpLen+1], format );
  HalLcdWriteString( (char*)buf, line );		
#endif
}

/**************************************************************************************************
 * @fn      HalLcdWriteStringValue
 *
 * @brief   Write a string followed by a value to the LCD
 *
 * @param   title   - Title that will be displayed before the value
 *          value1  - value #1
 *          format1 - redix of value #1
 *          value2  - value #2
 *          format2 - redix of value #2
 *          line    - line number
 *
 * @return  None
 **************************************************************************************************/
void HalLcdWriteStringValueValue( char *title, uint16 value1, uint8 format1,
                                  uint16 value2, uint8 format2, uint8 line )
{

#if (HAL_LCD == TRUE)

  uint8 tmpLen;
  uint8 buf[HAL_LCD_MAX_BUFF];
  uint32 err;

  tmpLen = (uint8)osal_strlen( (char*)title );
  if ( tmpLen )
  {
    osal_memcpy( buf, title, tmpLen );
    buf[tmpLen++] = ' ';
  }

  err = (uint32)(value1);
  _ltoa( err, &buf[tmpLen], format1 );
  tmpLen = (uint8)osal_strlen( (char*)buf );

  buf[tmpLen++] = ',';
  buf[tmpLen++] = ' ';
  err = (uint32)(value2);
  _ltoa( err, &buf[tmpLen], format2 );

  HalLcdWriteString( (char *)buf, line );		

#endif
}

/**************************************************************************************************
 * @fn      HalLcdWriteScreen
 *
 * @brief   Write a value to the LCD
 *
 * @param   line1  - string that will be displayed on line 1
 *          line2  - string that will be displayed on line 2
 *
 * @return  None
 **************************************************************************************************/
void HalLcdWriteScreen( char *line1, char *line2 )
{
#if (HAL_LCD == TRUE)
  HalLcdWriteString( line1, 1 );
  HalLcdWriteString( line2, 2 );
#endif
}

/**************************************************************************************************
 * @fn      HalLcdWriteValue
 *
 * @brief   Write a value to the LCD
 *
 * @param   value  - value that will be displayed
 *          radix  - 8, 10, 16
 *          option - display options
 *
 * @return  None
 **************************************************************************************************/
void HalLcdWriteValue ( uint32 value, const uint8 radix, uint8 option)
{
#if (HAL_LCD == TRUE)
  uint8 buf[HAL_LCD_MAX_BUFF];

  _ltoa( value, &buf[0], radix );
  HalLcdWriteString( (char*)buf, option );
#endif
}
/*********************************************************************
 * @fn      Board_writeString
 *
 * @brief   Write a string on the LCD display.
 *
 * @param   str - string to print
 * @param   line - line (page) to write (0-7)
 *
 * @return  void
 *
void Board_writeString(char *str, uint8_t line)
{
  HalLcdWriteString( (char*)str, line );
}

static LCD_Handle lcdHandle = NULL;
void Board_Lcd_writeStringValue(char *str, uint16_t value,
                                       uint8_t format,
                                       uint8_t line)
{
  HalLcdWriteString( (char*)str, line );
  //LCD_writeLine(lcdHandle, 0, str, value, format, line);
}*/